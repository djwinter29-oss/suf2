## firmware/boards/esp32s3/blink/main/Kconfig.projbuild
```kconfig
menu "SUF2 blink example"
    config SUF2_BLINK_GPIO
        int "GPIO for an external LED"
        range 0 48
        default 2
endmenu
```

## firmware/boards/esp32s3/sdkconfig.defaults
```kconfig
CONFIG_IDF_TARGET="esp32s3"
CONFIG_ESPTOOLPY_FLASHSIZE_4MB=y
CONFIG_PARTITION_TABLE_CUSTOM=y
CONFIG_PARTITION_TABLE_CUSTOM_FILENAME="../partitions.csv"
CONFIG_PARTITION_TABLE_OFFSET=0x20000
CONFIG_ESP_CONSOLE_UART_DEFAULT=y
CONFIG_ESP_CONSOLE_SECONDARY_NONE=y
CONFIG_BOOTLOADER_SKIP_VALIDATE_IN_DEEP_SLEEP=n
CONFIG_BOOTLOADER_SKIP_VALIDATE_ON_POWER_ON=n
CONFIG_BOOTLOADER_SKIP_VALIDATE_ALWAYS=n
CONFIG_BOOTLOADER_APP_TEST=n
CONFIG_BOOTLOADER_CUSTOM_RESERVE_RTC=y
CONFIG_BOOTLOADER_CUSTOM_RESERVE_RTC_SIZE=0x8
CONFIG_BOOTLOADER_CUSTOM_RESERVE_RTC_IN_CRC=n
CONFIG_ESP_MAIN_TASK_AFFINITY_CPU0=y
CONFIG_SECURE_BOOT=n
CONFIG_SECURE_FLASH_ENC_ENABLED=n
CONFIG_COMPILER_OPTIMIZATION_SIZE=y
```
